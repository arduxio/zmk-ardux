/*
 * Copyright (c) 2021 Mike "KemoNine" Crosson
 *
 * SPDX-License-Identifier: MIT
 */

#include <behaviors.dtsi>
#include <dt-bindings/zmk/keys.h>
#include <dt-bindings/zmk/bt.h>

// Enable ARDUX Right
#define ARDUX_RIGHT 1

// ARTS Row
#define KEY_A 1
#define KEY_R 2
#define KEY_T 3
#define KEY_S 4
// EYIO Row
#define KEY_E 6
#define KEY_N 7
#define KEY_I 8
#define KEY_O 9

// Define Offsets
#define LEADING_NONES NONE(0,0,1)
#define MIDDLE_NONES NONE(0, 0, 1)
#define TRAILING_NONES NONE(0, 0, 8)

// Thumb buttons (used for BT combos)
#define THUMB_1 15
#define THUMB_2 16
#define THUMB_3 17

// Include main ardux.io keymap
#include "../../../ardux.dtsi"
