## config/west.yml
```yaml
manifest:
  remotes:
    - name: zmkfirmware
      url-base: https://github.com/zmkfirmware
    - name: zmk-ardux
      url-base: https://github.com/arduxio
  projects:
    - name: zmk
      remote: zmkfirmware
      revision: 241ff39556b3685c9344c4c22fd9a655af8eb3ba
      import: app/west.yml
  self:
    path: config
```
